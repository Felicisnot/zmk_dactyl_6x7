## boards/shields/manuform_6x7/Kconfig.shield
```kconfig
config SHIELD_MANUFORM_6x7_LEFT
    def_bool $(shields_list_contains,manuform_6x7_left)

config SHIELD_MANUFORM_6x7_RIGHT
    def_bool $(shields_list_contains,manuform_6x7_right)
```

## config/boards/shields/dactyl_manuform_6x7/Kconfig.defconfig
```kconfig
if SHIELD_DACTYL_MANUFORM_6x7_LEFT

    config ZMK_KEYBOARD_NAME
        default "Manuform 6x7"

    config ZMK_SPLIT_BLE_ROLE_CENTRAL
        default y

endif

if SHIELD_DACTYL_MANUFORM_6x7_RIGHT

    config ZMK_KEYBOARD_NAME
        default "Manuform 6x7 (R)"

endif

if SHIELD_DACTYL_MANUFORM_6x7_LEFT || SHIELD_DACTYL_MANUFORM_6x7_RIGHT

    config ZMK_SPLIT
        default y

endif
```
